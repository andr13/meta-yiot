## conf/layer.conf
```bitbake
# We have a conf and classes directory, add to BBPATH
BBPATH .= ":${LAYERDIR}"

# We have recipes-* directories, add to BBFILES
BBFILES += "${LAYERDIR}/recipes-*/*/*.bb \
            ${LAYERDIR}/recipes-*/*/*.bbappend"

BBFILE_COLLECTIONS += "meta-yiot"
BBFILE_PATTERN_meta-yiot = "^${LAYERDIR}/"
BBFILE_PRIORITY_meta-yiot = "6"

LAYERDEPENDS_meta-yiot = "core"
LAYERSERIES_COMPAT_meta-yiot = "honister"
```
